## config/boards/shields/Chociroux/Kconfig.defconfig
```kconfig
# Copyright (c) 2020 The ZMK Contributors
# SPDX-License-Identifier: MIT

if SHIELD_CHOCIROUX_DONGLE

config ZMK_KEYBOARD_NAME
	default "Chociroux Dongle"
	
config ZMK_SPLIT_BLE_ROLE_CENTRAL
	default y
	
config ZMK_USB
	default y

endif

if SHIELD_CHOCIROUX_LEFT || SHIELD_CHOCIROUX_RIGHT || SHIELD_CHOCIROUX_DONGLE 

config ZMK_SPLIT
	default y

config ZMK_BLE
	default y
	
endif
```

## config/boards/shields/Chociroux/Kconfig.shield
```kconfig
# Copyright (c) 2020 The ZMK Contributors
# SPDX-License-Identifier: MIT

config SHIELD_CHOCIROUX_LEFT
	def_bool $(shields_list_contains,chociroux_left)

config SHIELD_CHOCIROUX_RIGHT
	def_bool $(shields_list_contains,chociroux_right)

config SHIELD_CHOCIROUX_DONGLE
	def_bool $(shields_list_contains,chociroux_dongle)
```
